## conf/bblayers.conf
```bitbake
# POKY_BBLAYERS_CONF_VERSION is increased each time build/conf/bblayers.conf
# changes incompatibly
POKY_BBLAYERS_CONF_VERSION = "2"

BBPATH = "${TOPDIR}"
BBFILES ?= ""

BBLAYERS ?= " \
  ../sources/poky/meta \
  ../sources/poky/meta-poky \
  ../sources/poky/meta-yocto-bsp \
  ../sources/meta-raspberrypi \
  "
```
